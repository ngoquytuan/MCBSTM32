//http://www.simplymodbus.ca/FC03.htm
#include "crc16.h"
#include "uart.h"
#include "modbus_phy_layer.h"
#include "modbus_app_layer.h"
#include "delay.h"
//define how to put a character to uart
void uart_putc(char c)
{
while (USART_GetFlagStatus(USART2, USART_FLAG_TC) == RESET); // wait for "Transmission Complete" flag cleared
		USART_SendData(USART2,c);
}
uint8_t modbus_serial_new = 0;

struct MODBUSRX modbus_rx;

/*Stages of MODBUS reception.  Used to keep our ISR fast enough.*/
enum {MODBUS_GETADDY=0, MODBUS_GETFUNC=1, MODBUS_GETDATA=2} modbus_serial_state = 0;


/*Global value holding our current CRC value.*/
union
{
    uint8_t b[2];
    uint16_t d;
} modbus_serial_crc;


//extern and put on SysTick_Handler
uint32_t modbus_sticks;
//uint32_t get_ticks(void)
//{
//	return modbus_sticks;
//}
/* status of between byte timeout */
//uint8_t modbus_timeout_enabled = _false;

//void set_ticks(uint32_t x)
//{
//	modbus_sticks = x;
//}
/* Table of CRC values for high–order byte */
const unsigned char modbus_auchCRCHi[] = {
0x00,0xC1,0x81,0x40,0x01,0xC0,0x80,0x41,0x01,0xC0,0x80,0x41,0x00,0xC1,0x81,
0x40,0x01,0xC0,0x80,0x41,0x00,0xC1,0x81,0x40,0x00,0xC1,0x81,0x40,0x01,0xC0,
0x80,0x41,0x01,0xC0,0x80,0x41,0x00,0xC1,0x81,0x40,0x00,0xC1,0x81,0x40,0x01,
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0x00,0xC1,0x81,0x40,0x01,0xC0,0x80,0x41,0x01,0xC0,0x80,0x41,0x00,0xC1,0x81,
0x40
};

/* Table of CRC values for low–order byte */
const unsigned char modbus_auchCRCLo[] = {
0x00,0xC0,0xC1,0x01,0xC3,0x03,0x02,0xC2,0xC6,0x06,0x07,0xC7,0x05,0xC5,0xC4,
0x04,0xCC,0x0C,0x0D,0xCD,0x0F,0xCF,0xCE,0x0E,0x0A,0xCA,0xCB,0x0B,0xC9,0x09,
0x08,0xC8,0xD8,0x18,0x19,0xD9,0x1B,0xDB,0xDA,0x1A,0x1E,0xDE,0xDF,0x1F,0xDD,
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0x44,0x84,0x85,0x45,0x87,0x47,0x46,0x86,0x82,0x42,0x43,0x83,0x41,0x81,0x80,
0x40
};

// Purpose:    Send a message over the RS485 bus
// Inputs:     1) The destination address
//             2) The number of bytes of data to send
//             3) A pointer to the data to send
//             4) The length of the data
// Outputs:    TRUE if successful
//             FALSE if failed
// Note:       Format:  source | destination | data-length | data | checksum
void modbus_serial_send_start( uint8_t to,  uint8_t func)
{
   modbus_serial_crc.d=0xFFFF;
   modbus_serial_new=FALSE;

   delay_us(3500000/MODBUS_SERIAL_BAUD); //3.5 character delay

   modbus_serial_putc(to);
   modbus_serial_putc(func);
}

// Purpose:    Ends a message over the RS485 Bus
// Inputs:     Character
// Outputs:    None
void modbus_serial_send_stop()
{
   uint8_t crc_low, crc_high;

   crc_high=modbus_serial_crc.b[1];
   crc_low=modbus_serial_crc.b[0];

   modbus_serial_putc(crc_high);
   modbus_serial_putc(crc_low);


   delay_us(3500000/MODBUS_SERIAL_BAUD); //3.5 character delay
   modbus_serial_crc.d=0xFFFF;
}



// Purpose:    Handles a timeout when waiting for a response
// Inputs:     None
// Outputs:    None
// Not used for ASCII mode
void modbus_timeout_now(void)
{
   if((modbus_serial_state == MODBUS_GETDATA) && (modbus_serial_crc.d == 0x0000) && (!modbus_serial_new))
   {
      modbus_rx.len-=2;
      modbus_serial_new=TRUE;
		  //printf("MODBUS DATA:%d %d %d %d %d %d\r\n",modbus_rx.data[0],modbus_rx.data[1],modbus_rx.data[2],modbus_rx.data[3],modbus_rx.data[4],modbus_rx.data[5]);
   } 
	 else 
	 {
      modbus_serial_new=FALSE;
   }

   modbus_serial_crc.d=0xFFFF;
   modbus_serial_state=MODBUS_GETADDY;
}
// Purpose:    Calculate crc of data and updates global crc
// Inputs:     Character
// Outputs:    None
void modbus_calc_crc(char data)
{
   uint8_t uIndex ; // will index into CRC lookup table

   uIndex = (modbus_serial_crc.b[1]) ^ data; // calculate the CRC
   modbus_serial_crc.b[1] = (modbus_serial_crc.b[0]) ^ modbus_auchCRCHi[uIndex];
   modbus_serial_crc.b[0] = modbus_auchCRCLo[uIndex];
}

// Purpose:    Puts a character onto the serial line
// Inputs:     Character
// Outputs:    None
void modbus_serial_putc(char c)
{
		// fputc(c, MODBUS_SERIAL);
		uart_putc(c);
		modbus_calc_crc(c);
		delay_us(1000000/MODBUS_SERIAL_BAUD); //one stop bit.  not exact
}

//Processing incomming data, put this fuction on uart receiver interrupt  
void incomming_modbus_serial(char c) {

   if (!modbus_serial_new)
   {
      if(modbus_serial_state == MODBUS_GETADDY)
      {
         modbus_serial_crc.d = 0xFFFF;
         modbus_rx.address = c;
         modbus_serial_state++;
         modbus_rx.len = 0;
         modbus_rx.error=0;
      }
      else if(modbus_serial_state == MODBUS_GETFUNC)
      {
         modbus_rx.func = c;
         modbus_serial_state++;
      }
      else if(modbus_serial_state == MODBUS_GETDATA)
      {
         if (modbus_rx.len>=MODBUS_SERIAL_RX_BUFFER_SIZE)
       {
         modbus_rx.len=MODBUS_SERIAL_RX_BUFFER_SIZE-1;
       }
         modbus_rx.data[modbus_rx.len]=c;
         modbus_rx.len++;
     }
     modbus_calc_crc(c);
   }

}

// Purpose:    Get a message from the RS485 bus and store it in a buffer
// Inputs:     None
// Outputs:    TRUE if a message was received
//             FALSE if no message is available
// Note:       Data will be filled in at the modbus_rx struct:
uint8_t modbus_kbhit()
{

   if(!modbus_serial_new) return FALSE;
   else if(modbus_rx.func & 0x80)           //did we receive an error?
   {
      modbus_rx.error = modbus_rx.data[0];  //if so grab the error and return true
      modbus_rx.len = 1;
   }
   modbus_serial_new=FALSE;
	 
   return TRUE;
}

